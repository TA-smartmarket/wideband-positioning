// ============================================================================
//  config.h — device configuration model
//
//  One firmware runs on every board. Role (tag/anchor), id, WiFi, server,
//  MQTT and anchor position are all runtime configuration stored in NVS.
//  See docs/API.md section 2 for the wire format.
// ============================================================================
#pragma once

#include <Arduino.h>
#include <Preferences.h>

// MAX_DEVICES must be defined BEFORE including DW1000Ranging.h. That library
// also #defines it (to 4), and without a guard it wins the include order: our
// 10 here is skipped, so "id 1..4" passed while "id 5..10" printed
// "id must be 1..10". The real value comes from -DMAX_DEVICES=10 in
// platformio.ini (so the library's own .cpp sees it too); this #ifndef simply
// keeps the header self-contained and avoids a redefinition.
#ifndef MAX_DEVICES
#define MAX_DEVICES 10      // ids 1..10 for both roles
#endif

#include "DW1000Ranging.h"

#define FW_VERSION      "1.0.31"
#define MAX_ANCHORS     10
#define MAX_TAGS        10
// Prefix for the setup access point. The advertised name is this plus a
// per-chip suffix (see apSsid()): three boards powered on together used to
// broadcast the identical "UWB-Setup", so a client could not tell which node
// it was about to configure and would often join the wrong one.
#define SSID_AP_PREFIX  "UWB-Setup"

enum Role : uint8_t { ROLE_NONE = 0, ROLE_TAG = 1, ROLE_ANCHOR = 2 };

// UWB PHY mode, selectable from the web UI / serial menu.
enum UwbMode : uint8_t {
    MODE_RANGE_LOWPOWER = 0,   // 110 kbps, 16 MHz PRF  (longest range)
    MODE_FAST_LOWPOWER,        // 6.8 Mbps, 16 MHz PRF
    MODE_LONGDATA_FAST_LP,     // 6.8 Mbps, 16 MHz PRF, long preamble
    MODE_FAST_ACCURACY,        // 6.8 Mbps, 64 MHz PRF  (best accuracy)
    MODE_LONGDATA_FAST_ACC,    // 6.8 Mbps, 64 MHz PRF, long preamble
    MODE_RANGE_ACCURACY,       // 110 kbps, 64 MHz PRF
    MODE_COUNT
};

struct Config {
    // identity
    Role     role = ROLE_NONE;
    uint8_t  id   = 0;
    char     site[16] = "home";

    // network
    char     wifi_ssid[33] = "";
    char     wifi_pass[65] = "";
    char     server_url[64] = "";   // http://host:8080
    char     api_token[40] = "";

    // mqtt
    bool     mqtt_enabled = false;
    char     mqtt_host[64] = "";
    uint16_t mqtt_port = 1883;
    char     mqtt_user[32] = "";
    char     mqtt_pass[32] = "";
    char     mqtt_base[32] = "uwb/home";

    // anchor placement (metres, origin = room corner)
    float    pos_x = 0.0f;
    float    pos_y = 0.0f;
    float    pos_z = 2.2f;

    // room bounds (used by the solver)
    float    room_w = 5.0f;
    float    room_h = 4.0f;

    // uwb
    UwbMode  uwb_mode = MODE_RANGE_LOWPOWER;
    bool     range_filter = true;
    uint16_t update_ms = 200;

    // Positions of every anchor, pushed by the server so a tag can solve its
    // own position without asking the server. Encoded "id:x,y;id:x,y".
    char     anchor_map[192] = "";

    // Height of this tag above the floor, in metres. Ranges are measured in 3D
    // between the anchor and the tag, so the horizontal distance the solver
    // needs is sqrt(r^2 - dz^2). The server pushes this value; without it the
    // solver used the raw 3D range and every position came out too far away.
    float    tag_z = 1.3f;

    // Display power saving. The OLED is the only always-on consumer on the
    // board; turning it off keeps WiFi, ranging and telemetry running.
    //   0 = always on, 1 = dim after screen_timeout_s, 2 = off after it
    uint8_t  screen_mode = 1;
    uint16_t screen_timeout_s = 60;   // 0 = never sleep

    // OTA (over-the-air update)
    // The device runs a web updater while it is on the network. A signed-in
    // server can push a firmware image with the shared token; nothing is
    // accepted without it.
    bool     ota_enabled = true;
    uint16_t ota_port = 3232;
    char     ota_token[40] = "";    // generated by the server, pushed in config
};

// ---------------------------------------------------------------------------
// helpers
// ---------------------------------------------------------------------------

inline const char *roleName(Role r)
{
    return r == ROLE_TAG ? "tag" : (r == ROLE_ANCHOR ? "anchor" : "unset");
}

// "anchor-1", "tag-3", "unset-0"
inline void deviceId(const Config &c, char *out, size_t n)
{
    snprintf(out, n, "%s-%u", roleName(c.role), (unsigned)c.id);
}

// The setup AP name, unique per chip:
//   "UWB-Setup-3476"   suffix = two device-specific MAC bytes
// Deliberately carries NO role or id: the role is picked during setup, so a
// name that said "tag-1" would be wrong for the very board being configured.
//
// The suffix must come from the DEVICE-SPECIFIC bytes. ESP.getEfuseMac()
// returns the MAC with the first octet in the least significant byte, so
// (mac>>40) and (mac>>32) are the two bytes that differ per board; taking
// (mac>>8) and mac instead reads the OUI, which is identical across a batch —
// two of these boards shared it and would have advertised the same name.
inline void apSsid(char *out, size_t n)
{
    const uint64_t mac = ESP.getEfuseMac();
    snprintf(out, n, "%s-%02X%02X", SSID_AP_PREFIX,
             (unsigned)((mac >> 40) & 0xFF), (unsigned)((mac >> 32) & 0xFF));
}

// Spread the setup APs across the three non-overlapping 2.4 GHz channels
// (1/6/11) so several nodes powered up together do not sit on the same one.
inline uint8_t apChannel()
{
    const uint64_t mac = ESP.getEfuseMac();
    static const uint8_t ch[3] = {1, 6, 11};
    return ch[(unsigned)((mac >> 40) & 0xFF) % 3];
}

// The DW1000 EUI is derived from role+id so no address is ever typed by hand.
//   anchor 1 -> "01:A0:5B:D5:A9:9A:E2:9C"   tag 1 -> "01:7D:00:22:EA:82:60:3B"
// With randomShortAddress=false the first two bytes become the short address,
// which is why the id sits there.
inline void deviceEui(const Config &c, char *out, size_t n)
{
    if (c.role == ROLE_ANCHOR)
        snprintf(out, n, "%02X:A0:5B:D5:A9:9A:E2:9C", (unsigned)c.id);
    else
        snprintf(out, n, "%02X:7D:00:22:EA:82:60:3B", (unsigned)c.id);
}

inline const byte *uwbModeBytes(UwbMode m)
{
    switch (m) {
    case MODE_FAST_LOWPOWER:       return DW1000.MODE_SHORTDATA_FAST_LOWPOWER;
    case MODE_LONGDATA_FAST_LP:    return DW1000.MODE_LONGDATA_FAST_LOWPOWER;
    case MODE_FAST_ACCURACY:       return DW1000.MODE_SHORTDATA_FAST_ACCURACY;
    case MODE_LONGDATA_FAST_ACC:   return DW1000.MODE_LONGDATA_FAST_ACCURACY;
    case MODE_RANGE_ACCURACY:      return DW1000.MODE_LONGDATA_RANGE_ACCURACY;
    default:                       return DW1000.MODE_LONGDATA_RANGE_LOWPOWER;
    }
}

inline const char *uwbModeName(UwbMode m)
{
    switch (m) {
    case MODE_FAST_LOWPOWER:     return "shortdata_fast_lowpower";
    case MODE_LONGDATA_FAST_LP:  return "longdata_fast_lowpower";
    case MODE_FAST_ACCURACY:     return "shortdata_fast_accuracy";
    case MODE_LONGDATA_FAST_ACC: return "longdata_fast_accuracy";
    case MODE_RANGE_ACCURACY:    return "longdata_range_accuracy";
    default:                     return "longdata_range_lowpower";
    }
}

inline UwbMode uwbModeFromName(const char *s)
{
    if (!s) return MODE_RANGE_LOWPOWER;
    if (!strcmp(s, "shortdata_fast_lowpower"))   return MODE_FAST_LOWPOWER;
    if (!strcmp(s, "longdata_fast_lowpower"))    return MODE_LONGDATA_FAST_LP;
    if (!strcmp(s, "shortdata_fast_accuracy"))   return MODE_FAST_ACCURACY;
    if (!strcmp(s, "longdata_fast_accuracy"))    return MODE_LONGDATA_FAST_ACC;
    if (!strcmp(s, "longdata_range_accuracy"))   return MODE_RANGE_ACCURACY;
    return MODE_RANGE_LOWPOWER;
}

// Parse the anchor map "1:0,0;2:5,0" and return the position of anchor `id`.
// Anchor height used when the server did not send one. Matches the default the
// server and the UI assume, so the two agree before anything is configured.
#define ANCHOR_DEFAULT_Z 2.2f

inline bool anchorPos(const Config &c, uint8_t id, float &x, float &y, float *z = nullptr)
{
    const char *p = c.anchor_map;
    while (*p) {
        while (*p == ';' || *p == ' ') p++;
        if (!*p) break;
        int aid = atoi(p);
        const char *colon = strchr(p, ':');
        if (!colon) break;
        float ax = atof(colon + 1);
        const char *comma = strchr(colon + 1, ',');
        if (!comma) break;
        float ay = atof(comma + 1);
        if (aid == (int)id) {
            x = ax; y = ay;
            if (z) *z = ANCHOR_DEFAULT_Z;   // map carries x,y only
            return true;
        }
        const char *semi = strchr(comma, ';');
        if (!semi) break;
        p = semi + 1;
    }
    return false;
}

// ---------------------------------------------------------------------------
// NVS persistence
// ---------------------------------------------------------------------------

inline void configLoad(Config &c)
{
    Preferences p;
    if (!p.begin("uwbcfg", true)) return;   // read-only
    c.role = (Role)p.getUChar("role", ROLE_NONE);
    c.id   = p.getUChar("id", 0);
    p.getString("site", c.site, sizeof(c.site));
    p.getString("wssid", c.wifi_ssid, sizeof(c.wifi_ssid));
    p.getString("wpass", c.wifi_pass, sizeof(c.wifi_pass));
    p.getString("surl", c.server_url, sizeof(c.server_url));
    p.getString("tok", c.api_token, sizeof(c.api_token));
    c.mqtt_enabled = p.getBool("mq_en", false);
    p.getString("mq_host", c.mqtt_host, sizeof(c.mqtt_host));
    c.mqtt_port = p.getUShort("mq_port", 1883);
    p.getString("mq_user", c.mqtt_user, sizeof(c.mqtt_user));
    p.getString("mq_pass", c.mqtt_pass, sizeof(c.mqtt_pass));
    p.getString("mq_base", c.mqtt_base, sizeof(c.mqtt_base));
    c.pos_x = p.getFloat("px", 0.0f);
    c.pos_y = p.getFloat("py", 0.0f);
    c.pos_z = p.getFloat("pz", 2.2f);
    c.room_w = p.getFloat("rw", 5.0f);
    c.room_h = p.getFloat("rh", 4.0f);
    c.uwb_mode = (UwbMode)p.getUChar("uwbm", MODE_RANGE_LOWPOWER);
    c.range_filter = p.getBool("rfilt", true);
    c.update_ms = p.getUShort("upd", 200);
    p.getString("amap", c.anchor_map, sizeof(c.anchor_map));
    c.tag_z = p.getFloat("tagz", 1.3f);
    c.screen_mode = p.getUChar("scr_mode", 1);
    c.screen_timeout_s = p.getUShort("scr_to", 60);
    c.ota_enabled = p.getBool("ota_en", true);
    c.ota_port = p.getUShort("ota_port", 3232);
    p.getString("ota_tok", c.ota_token, sizeof(c.ota_token));
    p.end();
}

inline void configSave(const Config &c)
{
    Preferences p;
    if (!p.begin("uwbcfg", false)) return;  // read-write
    p.putUChar("role", (uint8_t)c.role);
    p.putUChar("id", c.id);
    p.putString("site", c.site);
    p.putString("wssid", c.wifi_ssid);
    p.putString("wpass", c.wifi_pass);
    p.putString("surl", c.server_url);
    p.putString("tok", c.api_token);
    p.putBool("mq_en", c.mqtt_enabled);
    p.putString("mq_host", c.mqtt_host);
    p.putUShort("mq_port", c.mqtt_port);
    p.putString("mq_user", c.mqtt_user);
    p.putString("mq_pass", c.mqtt_pass);
    p.putString("mq_base", c.mqtt_base);
    p.putFloat("px", c.pos_x);
    p.putFloat("py", c.pos_y);
    p.putFloat("pz", c.pos_z);
    p.putFloat("rw", c.room_w);
    p.putFloat("rh", c.room_h);
    p.putUChar("uwbm", (uint8_t)c.uwb_mode);
    p.putBool("rfilt", c.range_filter);
    p.putUShort("upd", c.update_ms);
    p.putString("amap", c.anchor_map);
    p.putFloat("tagz", c.tag_z);
    p.putUChar("scr_mode", c.screen_mode);
    p.putUShort("scr_to", c.screen_timeout_s);
    p.putBool("ota_en", c.ota_enabled);
    p.putUShort("ota_port", c.ota_port);
    p.putString("ota_tok", c.ota_token);
    p.end();
}

inline void configClear()
{
    Preferences p;
    if (p.begin("uwbcfg", false)) { p.clear(); p.end(); }
}