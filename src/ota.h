// ============================================================================
//  ota.h — over-the-air firmware update, with a server-issued key
//
//  Two independent paths, both key-protected:
//
//  1. PULL (primary, recommended)
//     The device asks the server for the newest image and installs it itself:
//
//         GET  <server>/api/v1/ota/check?device=<id>&key=<key>
//         POST <server>/api/v1/ota/ack   {"device":..,"key":..,"status":..}
//
//     A pull is far more robust on this hardware than a push: the ESP32
//     WebServer buffers request bodies in RAM and drops a ~1 MB multipart POST
//     before the handler even runs (observed: the device logs nothing and the
//     client sees a connection reset). Downloading as the client avoids that
//     entirely, and HTTPUpdate streams the image straight into the OTA
//     partition.
//
//  2. PUSH (fallback, for a laptop on the same LAN)
//     The device also runs a small web updater:
//         POST http://<device-ip>:3232/update?key=<key>   (multipart .bin)
//     Guarded by the same key, which lives in NVS.
//
//  Security model
//  --------------
//  * the key is generated by the server (per device) and pushed through the
//    normal config channel; nothing is installed without it
//  * a wipe (`reset` on the serial menu) clears the key, disabling remote
//    updates until the server provisions the device again
// ============================================================================
#pragma once

#include <Arduino.h>
#include <WebServer.h>
#include <Update.h>
#include <WiFi.h>
#include <HTTPClient.h>
#include <HTTPUpdate.h>
#include "config.h"
#include "net.h"

extern WebServer g_ota;   // defined in main.cpp
extern bool ota_busy;     // set while an OTA download is in progress

// Every background task we own, so the OTA can park all of them while it
// writes flash. Suspending them is exactly the right move here: writing flash
// disables the instruction cache, and any task that keeps running (and touches
// the network or the filesystem) faults with a corrupted backtrace.
#define OTA_MAX_TASKS 4
extern TaskHandle_t ota_suspend_list[OTA_MAX_TASKS];
extern int          ota_suspend_count;
extern TaskHandle_t ota_self;          // the pull task (never suspends itself)

static bool taskRegistered(TaskHandle_t h)
{
    for (int i = 0; i < ota_suspend_count; i++)
        if (ota_suspend_list[i] == h) return true;
    return false;
}

// Park every registered task except the caller.
static void otaParkOthers()
{
    for (int i = 0; i < ota_suspend_count; i++) {
        TaskHandle_t h = ota_suspend_list[i];
        if (h && h != ota_self) vTaskSuspend(h);
    }
    vTaskDelay(pdMS_TO_TICKS(120));    // let them actually stop
}

static void otaResumeOthers()
{
    for (int i = 0; i < ota_suspend_count; i++) {
        TaskHandle_t h = ota_suspend_list[i];
        if (h && h != ota_self) vTaskResume(h);
    }
}

// upload state (single upload at a time)
static bool ota_rejected = false;
static bool ota_ok = false;

// pull state
static void otaReport(bool ok, const String &msg);
static uint32_t ota_last_check_ms = 0;
static const uint32_t OTA_CHECK_INTERVAL_MS = 60000;   // ask every minute

// ---------------------------------------------------------------------------
// push: web updater on the device
// ---------------------------------------------------------------------------
inline bool otaKeyOk()
{
    if (!cfg.ota_token[0]) return false;
    if (!g_ota.hasArg("key")) return false;
    return g_ota.arg("key") == cfg.ota_token;
}

inline void otaUploadStart()
{
    HTTPUpload &up = g_ota.upload();

    if (up.status == UPLOAD_FILE_START) {
        // Authenticate BEFORE opening the flash partition.
        if (!otaKeyOk()) {
            Serial.println(F("[ota] push rejected: bad or missing key"));
            ota_rejected = true;
            return;
        }
        ota_rejected = false;
        Serial.printf("[ota] push: receiving %s (%u bytes)\n",
                      up.filename.c_str(), (unsigned)up.totalSize);

        const size_t clen = g_ota.clientContentLength();
        size_t target = (clen > 1024) ? clen : up.totalSize;
        if (!Update.begin(target > 1024 ? target : UPDATE_SIZE_UNKNOWN)) {
            Serial.printf("[ota] Update.begin failed: %s\n", Update.errorString());
            ota_rejected = true;
        }
    } else if (up.status == UPLOAD_FILE_WRITE) {
        if (ota_rejected) return;
        if (Update.write(up.buf, up.currentSize) != up.currentSize) {
            Serial.printf("[ota] write failed: %s\n", Update.errorString());
            ota_rejected = true;
        }
    } else if (up.status == UPLOAD_FILE_END) {
        if (ota_rejected) { Update.abort(); return; }
        if (Update.end(true)) {
            Serial.printf("[ota] push complete, %u bytes — rebooting\n",
                          (unsigned)up.totalSize);
            ota_ok = true;
        } else {
            Serial.printf("[ota] Update.end failed: %s\n", Update.errorString());
            ota_rejected = true;
        }
    } else if (up.status == UPLOAD_FILE_ABORTED) {
        Update.abort();
        ota_rejected = true;
        Serial.println(F("[ota] push aborted"));
    }
}

inline void otaRegister()
{
    g_ota.on("/update", HTTP_POST,
        []() {
            // Report the real outcome. Update.hasError() is false when no
            // upload happened at all, so it must not be used alone: doing so
            // made an empty POST look successful and reboot the node.
            const bool ok = ota_ok && !Update.hasError();
            g_ota.sendHeader("Connection", "close");
            g_ota.send(ok ? 200 : 500, "text/plain", ok ? "OK: rebooting" : "FAILED");
            ota_ok = false;
            if (ok) { delay(300); ESP.restart(); }
        },
        otaUploadStart);

    g_ota.on("/", HTTP_GET, []() {
        char id[16], eui[40];
        deviceId(cfg, id, sizeof(id));
        deviceEui(cfg, eui, sizeof(eui));
        char page[520];
        snprintf(page, sizeof(page),
                 "<!doctype html><meta name=viewport content='width=device-width,initial-scale=1'>"
                 "<body style=\"font:14px system-ui;background:#0b0e1a;color:#e8ecf8;padding:20px\">"
                 "<h2>UWB node</h2><p><b>%s</b><br>EUI <code>%s</code><br>firmware %s</p>"
                 "<p>IP %s &middot; RSSI %d dBm</p>"
                 "<p>Server-pull OTA: %s</p>"
                 "<form method=post action='/update' enctype='multipart/form-data'>"
                 "<input type=file name=firmware required> "
                 "<input name=key placeholder='server key' required> "
                 "<button>Upload</button></form></body>",
                 id, eui, FW_VERSION,
                 WiFi.localIP().toString().c_str(), (int)WiFi.RSSI(),
                 cfg.ota_enabled ? "enabled" : "disabled");
        g_ota.send(200, "text/html", page);
    });
}

// ---------------------------------------------------------------------------
// pull: ask the server whether a newer image exists
// ---------------------------------------------------------------------------
inline void otaCheckNow(bool force = false)
{
    if (!cfg.ota_enabled || !net.wifi_up || cfg.server_url[0] == 0) return;
    if (!cfg.ota_token[0]) return;
    if (!force && millis() - ota_last_check_ms < OTA_CHECK_INTERVAL_MS) return;
    ota_last_check_ms = millis();

    char id[16];
    deviceId(cfg, id, sizeof(id));

    char url[220];
    snprintf(url, sizeof(url), "%s/api/v1/ota/check?device=%s&key=%s",
             cfg.server_url, id, cfg.ota_token);

    HTTPClient http;
    if (!http.begin(url)) return;
    http.setTimeout(6000);
    const int code = http.GET();
    if (code == 200) {
        String body = http.getString();
        // tiny payload: {"ok":true,"update":true,"url":"...","version":"1.0.5"}
        if (body.indexOf("\"update\":true") >= 0) {
            int u = body.indexOf("\"url\":\"");
            int v = body.indexOf("\"version\":\"");
            String dl, ver;
            if (u >= 0) { int e = body.indexOf('"', u + 7); dl = body.substring(u + 7, e); }
            if (v >= 0) { int e = body.indexOf('"', v + 11); ver = body.substring(v + 11, e); }

            Serial.printf("[ota] server offers %s — downloading\n", ver.c_str());
            http.end();

            // Measure the free stack AT THE POINT OF USE: the earlier headroom
            // report ran after a cycle that had nothing to download, so it did
            // not reflect the download path at all.
            ota_busy = true;
            otaParkOthers();
            // Let the other network tasks drain before flash writes start:
            // writing disables the instruction cache and any task still
            // running from flash on the other core faults (CORRUPTED
            // backtrace). Everything network-related now lives on core 0.
            vTaskDelay(pdMS_TO_TICKS(1200));
            Serial.printf("[ota] stack before download: %u bytes free\n",
                          (unsigned)(uxTaskGetStackHighWaterMark(nullptr) * sizeof(StackType_t)));

            // Manual, step-by-step download instead of httpUpdate.update():
            // every phase is logged and the reboot is ours to make, so a
            // failure names the exact step (the library's own backtraces came
            // out corrupted and proved useless).
            HTTPClient dlHttp;
            if (!dlHttp.begin(dl)) {
                Serial.println(F("[ota] cannot open the download URL"));
                ota_busy = false;
                otaResumeOthers();
                otaReport(false, "begin failed");
                return;
            }
            dlHttp.setTimeout(20000);
            const int code2 = dlHttp.GET();
            const int len = dlHttp.getSize();
            Serial.printf("[ota] GET -> %d, size %d\n", code2, len);
            if (code2 != 200 || len <= 0) {
                Serial.println(F("[ota] download refused"));
                dlHttp.end();
                ota_busy = false;
                otaResumeOthers();
                otaReport(false, "http error");
                return;
            }

            if (!Update.begin((size_t)len)) {
                Serial.printf("[ota] Update.begin failed: %s\n", Update.errorString());
                dlHttp.end();
                ota_busy = false;
                otaResumeOthers();
                otaReport(false, Update.errorString());
                return;
            }
            Serial.printf("[ota] writing %d bytes\n", len);

            WiFiClient *stream = dlHttp.getStreamPtr();
            uint8_t buf[2048];
            size_t written = 0;
            uint32_t lastLog = 0;
            while (written < (size_t)len) {
                const size_t avail = stream->available();
                if (avail) {
                    const int n = stream->readBytes(buf, min(avail, sizeof(buf)));
                    if (n > 0) {
                        if (Update.write(buf, n) != (size_t)n) {
                            Serial.printf("[ota] write failed at %u: %s\n",
                                          (unsigned)written, Update.errorString());
                            break;
                        }
                        written += n;
                        if (written - lastLog >= 262144) {
                            lastLog = written;
                            Serial.printf("[ota] progress %u/%d\n",
                                          (unsigned)written, len);
                        }
                    }
                } else {
                    vTaskDelay(pdMS_TO_TICKS(5));
                }
                if (!dlHttp.connected() && !avail) break;
            }
            dlHttp.end();

            Serial.printf("[ota] downloaded %u/%d bytes\n", (unsigned)written, len);
            if (written == (size_t)len && Update.end(true)) {
                Serial.println(F("[ota] image written OK — rebooting"));
                otaReport(true, "");
                ota_busy = false;
                delay(300);
                ESP.restart();
            } else {
                Serial.printf("[ota] FAILED: %s\n", Update.errorString());
                Update.abort();
                ota_busy = false;
                otaResumeOthers();
                otaReport(false, Update.errorString());
            }
        }
    }
    http.end();
}

// Tell the server how it went (best effort; the node reboots on success).
inline void otaReport(bool ok, const String &msg)
{
    if (!net.wifi_up || cfg.server_url[0] == 0 || !cfg.ota_token[0]) return;
    char id[16];
    deviceId(cfg, id, sizeof(id));

    char url[160];
    snprintf(url, sizeof(url), "%s/api/v1/ota/ack", cfg.server_url);

    char payload[320];
    snprintf(payload, sizeof(payload),
             "{\"device\":\"%s\",\"key\":\"%s\",\"ok\":%s,\"version\":\"%s\",\"error\":\"%s\"}",
             id, cfg.ota_token, ok ? "true" : "false", FW_VERSION,
             msg.length() > 80 ? msg.substring(0, 80).c_str() : msg.c_str());

    HTTPClient http;
    if (!http.begin(url)) return;
    http.setTimeout(4000);
    http.addHeader("Content-Type", "application/json");
    http.POST(payload);
    http.end();
}

// ---------------------------------------------------------------------------
// lifecycle
// ---------------------------------------------------------------------------

// The push updater runs in its OWN FreeRTOS task: handleClient() called from
// the main loop is starved by DW1000Ranging.loop().
static void otaTask(void *)
{
    for (;;) {
        if (cfg.ota_enabled && net.wifi_up && !ota_busy) g_ota.handleClient();
        vTaskDelay(pdMS_TO_TICKS(2));
    }
}

// The pull check + download MUST NOT run in the Arduino loop task: HTTPUpdate
// pulls in HTTPClient, TLS glue and several String buffers, far more than the
// 8 KB that task has. Overflowing it does NOT print "stack overflow" — it
// shows up as
//   assert failed: xQueueSemaphoreTake queue.c:1554
//   Backtrace: ... |<-CORRUPTED
// and 16 KB was still not enough. The task now runs with 32 KB and reports its
// remaining stack once, so the margin is measured rather than assumed.
#define OTA_PULL_STACK 49152

static void otaPullTask(void *)
{
    ota_self = xTaskGetCurrentTaskHandle();  // never suspend ourselves
    vTaskDelay(pdMS_TO_TICKS(15000));       // let WiFi settle first
    bool reported = false;
    for (;;) {
        otaCheckNow(false);
        vTaskDelay(pdMS_TO_TICKS(OTA_CHECK_INTERVAL_MS));
    }
}

inline void otaBegin()
{
    if (!cfg.ota_enabled || !net.wifi_up) return;
    static bool started = false;
    if (started) return;
    otaRegister();
    g_ota.begin(cfg.ota_port);
    xTaskCreatePinnedToCore(otaTask, "ota", 8192, nullptr, 1, nullptr, 0);
    xTaskCreatePinnedToCore(otaPullTask, "otapull", OTA_PULL_STACK, nullptr, 2, nullptr, 0);
    started = true;
    Serial.printf("[ota] updater on http://%s:%u/update (key required)\n",
                  WiFi.localIP().toString().c_str(), (unsigned)cfg.ota_port);
}

// Kept for compatibility with the main loop; the tasks do the real work.
inline void otaLoop() { }
